/*
 * selftest.ino — replays the FOF-1 vectors (vectors.h, generated by eval/gen_vectors.py) through the fof1 library
 * and prints one PASS/FAIL line per vector over USB serial. This is the test suite for firmware/iff: it runs on
 * Ihan's bench over USB-C without the phone. Until stream 2 implements fof1.cpp every vector prints FAIL with the
 * step that failed ("day_key"), which is the expected starting state.
 *
 * Build: Arduino IDE 2.x (open this folder; the fof1 library must be in your Arduino libraries folder, see
 * firmware/README.md) or `arduino-cli compile --fqbn <board> --library ../iff firmware/selftest`.
 */
#include <fof1.h>
#include "vectors.h"

static bool eq(const uint8_t* a, const uint8_t* b, size_t n) {
  for (size_t i = 0; i < n; i++) if (a[i] != b[i]) return false;
  return true;
}

/* Runs one vector; returns NULL on PASS or the name of the first failing step. */
static const char* runVector(const fof1_vector& v) {
  uint8_t day_key[FOF1_KEY_LEN];
  uint8_t drone_key[FOF1_KEY_LEN];
  uint8_t challenge[FOF1_CHALLENGE_LEN];
  uint8_t response[FOF1_RESPONSE_LEN];
  char day[8];
  fof1_challenge ch;
  fof1_nonce_ledger ledger;

  if (fof1_day_of(v.t, day) != FOF1_OK || memcmp(day, v.day, 8) != 0) return "day_of";
  if (fof1_derive_day_key(v.master_key, v.day, day_key) != FOF1_OK || !eq(day_key, v.day_key, FOF1_KEY_LEN)) return "day_key";
  if (fof1_derive_drone_key(day_key, v.drone_id, drone_key) != FOF1_OK || !eq(drone_key, v.drone_key, FOF1_KEY_LEN)) return "drone_key";
  if (fof1_build_challenge(day_key, v.nonce, v.t, v.challenger_id, challenge) != FOF1_OK ||
      !eq(challenge, v.challenge, FOF1_CHALLENGE_LEN)) return "build_challenge";
  if (fof1_check_challenge(day_key, v.challenge, &ch) != FOF1_FRIEND) return "check_challenge";
  if (ch.t != v.t || ch.challenger_id != v.challenger_id || !eq(ch.nonce, v.nonce, FOF1_NONCE_LEN)) return "parse_challenge";

  if (v.has_response && v.response_is_honest) {
    fof1_position pos = { v.resp_lat_e4, v.resp_lon_e4, v.resp_alt_10m };
    if (fof1_build_response(drone_key, &ch, v.drone_id, &pos, response) != FOF1_OK ||
        !eq(response, v.response, FOF1_RESPONSE_LEN)) return "build_response";
  }

  fof1_ledger_init(&ledger);
  if (fof1_ledger_issue(&ledger, v.nonce, v.t) != FOF1_OK) return "ledger_issue";
  if (v.nonce_consumed_before && fof1_ledger_consume(&ledger, v.nonce, v.now) != FOF1_FRIEND) return "ledger_consume";

  fof1_position observer = { v.obs_lat_e4, v.obs_lon_e4, v.obs_alt_10m };
  fof1_verdict verdict = fof1_verify_response(day_key, &ledger, &ch, v.has_response ? v.response : NULL,
                                              v.response_ms, &observer, v.obs_heading_deg, v.now, NULL);
  if ((uint8_t)verdict != v.expected_verdict) return "verify_response";
  return NULL;
}

void setup() {
  Serial.begin(115200);
  while (!Serial) { delay(10); }  // native USB CDC boards wait for the host
  delay(500);
  Serial.println(F("FOF-1 selftest (fof1 0.1.0)"));

  int passed = 0;
  for (size_t i = 0; i < FOF1_VECTOR_COUNT; i++) {
    const fof1_vector& v = FOF1_VECTORS[i];
    const char* failedStep = runVector(v);
    if (failedStep == NULL) {
      passed++;
      Serial.print(F("PASS ")); Serial.println(v.name);
    } else {
      Serial.print(F("FAIL ")); Serial.print(v.name);
      Serial.print(F(" at ")); Serial.print(failedStep);
      Serial.print(F(" (expected ")); Serial.print(fof1_verdict_word((fof1_verdict)v.expected_verdict));
      if (v.expected_reason) { Serial.print(F(" · ")); Serial.print(v.expected_reason); }
      Serial.println(F(")"));
    }
  }
  Serial.print(passed); Serial.print(F("/")); Serial.print((int)FOF1_VECTOR_COUNT); Serial.println(F(" PASS"));
}

void loop() {
  delay(1000);  // TODO(stream 2): re-run on any byte received, so the bench can re-test without a reset
}
